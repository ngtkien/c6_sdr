## CMakeLists.txt
```
# SPDX-License-Identifier: Apache-2.0

cmake_minimum_required(VERSION 3.20.0)
find_package(Zephyr REQUIRED HINTS $ENV{ZEPHYR_BASE})
project(c6_sdr CXX)

target_sources(app PRIVATE
	src/main.cpp
	src/sdr.cpp
	src/audio.cpp
)
# ESP32-P4 spectrum / raw-IQ front-end driven through the c6_sdr hybrid
# slave firmware on the ESP32-C6 over the ESP-Hosted SDIO link.
#
#   west build -b esp32p4_function_ev_v1/esp32p4/hpcore --sysbuild
```

## Kconfig
```
# Copyright (c) Cognition
# SPDX-License-Identifier: Apache-2.0

mainmenu "c6_sdr — ESP32-P4 driving c6_sdr hybrid slave firmware"

config C6_SDR_SWEEP_LO_MHZ
	int "Sweep start frequency (MHz)"
	default 2400

config C6_SDR_SWEEP_HI_MHZ
	int "Sweep end frequency (MHz)"
	default 2500

config C6_SDR_SWEEP_STEP_MHZ
	int "Sweep step (MHz)"
	default 20

config C6_SDR_SPEC_MS
	int "Per-point SPEC run duration (ms)"
	default 500
	help
	  Bounded ring-capture run per frequency point; frames stream back
	  while the capture still runs, so the slave's 24 KiB ring only
	  has to cover pull latency. Longer runs amortize the per-run
	  start/drain overhead → faster waterfall scroll.

config C6_SDR_RUNS
	int "Number of sweep repetitions (0 = forever)"
	default 0
	help
	  0 keeps sweeping indefinitely — the usual choice when the DSI
	  waterfall is the live display.

config C6_SDR_DSI_VIEW
	int "Initial DSI view (0=waterfall, 1=spectrum trace, 2=panorama, 3=iq scope)"
	default 1
	range 0 3
	depends on C6_SDR_DSI
	help
	  Each view owns the full area below the HUD; BOOT button cycles:
	    0 = scrolling waterfall
	    1 = live max-hold spectrum trace of the current block
	    2 = max-hold panorama across the whole sweep range

config C6_SDR_NFFT
	int "FFT size (power of two)"
	default 256

config C6_SDR_STRIDE
	int "FFT stride (process every Nth unit block)"
	default 1
	help
	  1 = every captured unit produces an FFT (max frame rate).

config C6_SDR_UNITS_PER_FRAME
	int "Units merged per emitted frame"
	default 2
	help
	  Smaller values emit more, thinner frames — faster waterfall
	  scroll at lower per-row integration.

config C6_SDR_MAX_HOLD
	bool "Per-bin max-hold instead of mean power"
	default n

config C6_SDR_GAIN
	int "RX gain code (0..54, 255=HW AGC, 256=keep)"
	default 255

config C6_SDR_DCAP
	int "Analog filter code (0..63, 254=auto, 255=keep)"
	default 254

config C6_SDR_DSI
	bool "Render waterfall on the DSI panel"
	default y

config C6_SDR_ASCII_WF
	bool "ASCII waterfall rows on the serial console"
	default y if !C6_SDR_DSI
	help
	  The 96-column text waterfall is heavy on a 115200 UART; leave it
	  off when the DSI panel carries the display. Sweep summaries and
	  errors are always printed.

config C6_SDR_SD_DUMP
	bool "Append captures to files on the SD card"
	default y

config C6_SDR_IQ_BURST
	bool "Run a single-shot raw-I/Q burst after the sweep"
	default y

config C6_SDR_IQ_FREQ_MHZ
	int "I/Q burst center frequency (MHz)"
	default 2440

source "Kconfig.zephyr"
```

## prj.conf
```kconfig
CONFIG_PRINTK=y
CONFIG_LOG=y
CONFIG_LOG_MODE_IMMEDIATE=y
CONFIG_MAIN_STACK_SIZE=16384
CONFIG_REQUIRES_FLOAT_PRINTF=y
CONFIG_CPP=y

# bsp_init() touches i2c0 (LDOs)
CONFIG_I2C=y

# capture buf + app framebuffer live in PSRAM (.ext_ram.bss); the DSI
# driver additionally allocs 2 x 1.8MB ping-pong fbs from the heap
CONFIG_ESP_SPIRAM=y
CONFIG_ESP_SPIRAM_HEAP_SIZE=8388608
CONFIG_HEAP_MEM_POOL_SIZE=32768

# ESP32-C6 co-processor on SDIO slot 1 (esp_hosted_ng driver)
CONFIG_NETWORKING=y
CONFIG_WIFI=y
CONFIG_SDHC=y
CONFIG_SDIO_STACK=y

# SD card on SDIO slot 0 receives capture dumps
CONFIG_DISK_ACCESS=y
CONFIG_FILE_SYSTEM=y
CONFIG_FAT_FILESYSTEM_ELM=y
CONFIG_FS_FATFS_LFN=y
CONFIG_FILE_SYSTEM_MKFS=y
CONFIG_FS_FATFS_MOUNT_MKFS=y

# EK79007 DSI waterfall
CONFIG_DISPLAY=y
CONFIG_MIPI_DSI=y
CONFIG_MIPI_DSI_ESP32P4_ZERO_COPY=y

CONFIG_GPIO=y
CONFIG_SERIAL=y
CONFIG_UART_CONSOLE=y
CONFIG_UART_ESP32=y

# GT911 capacitive touch (LCD sub-board, I2C polling)
CONFIG_INPUT=y
CONFIG_INPUT_GT911=y
CONFIG_INPUT_GT911_PERIOD_MS=20

# ES8311 speaker out (demod blips in IQ view)
CONFIG_I2S=n
CONFIG_AUDIO=n
CONFIG_AUDIO_CODEC=n
```

## src/audio.cpp
```c
/* ES8311 speaker output — init + fire-and-forget PCM writes onto i2s0.
 * Pattern follows projects/esp32p4-ai-hub/src/beep.cpp: codec as clock
 * slave, i2s0 as master, silence preloaded so TX stays armed. */

#include <string.h>
#include <zephyr/kernel.h>
#include <zephyr/device.h>
#include <zephyr/drivers/i2s.h>
#include <zephyr/audio/codec.h>
#include <zephyr/logging/log.h>

#include <bsp/esp32p4_bsp.h>

#include "audio.h"

#if CONFIG_I2S

LOG_MODULE_REGISTER(audio, LOG_LEVEL_INF);

#define SAMPLE_RATE   48000
#define WORD_SIZE     16
#define NUM_CHANNELS  2
#define BLOCK_FRAMES  1024
#define NUM_BLOCKS    4
#define BLOCK_BYTES   (BLOCK_FRAMES * NUM_CHANNELS * sizeof(int16_t))

K_MEM_SLAB_DEFINE_STATIC(audio_slab, BLOCK_BYTES, NUM_BLOCKS, 4);

static const struct device *i2s_dev;
static bool ok;

int audio_init(void)
{
	const struct device *codec = DEVICE_DT_GET(DT_NODELABEL(es8311));

	i2s_dev = DEVICE_DT_GET(DT_NODELABEL(i2s0));
	if (!device_is_ready(codec) || !device_is_ready(i2s_dev)) {
		LOG_WRN("audio devices not ready");
		return -ENODEV;
	}

	audio_dai_cfg_t dai = {};
	dai.i2s.word_size = WORD_SIZE;
	dai.i2s.channels = NUM_CHANNELS;
	dai.i2s.format = I2S_FMT_DATA_FORMAT_I2S;
	dai.i2s.options = I2S_OPT_BIT_CLK_SLAVE | I2S_OPT_FRAME_CLK_SLAVE;
	dai.i2s.frame_clk_freq = SAMPLE_RATE;
	struct audio_codec_cfg codec_cfg = {
		.mclk_freq = DT_PROP(DT_NODELABEL(es8311), mclk_frequency_hz),
		.dai_type = AUDIO_DAI_TYPE_I2S,
		.dai_cfg = dai,
		.dai_route = AUDIO_ROUTE_PLAYBACK,
	};
	if (audio_codec_configure(codec, &codec_cfg)) {
		LOG_WRN("codec configure failed");
		return -EIO;
	}
	audio_codec_start(codec, AUDIO_DAI_DIR_TX);

	struct i2s_config i2s_cfg = {
		.word_size = WORD_SIZE,
		.channels = NUM_CHANNELS,
		.format = I2S_FMT_DATA_FORMAT_I2S,
		.options = I2S_OPT_BIT_CLK_MASTER | I2S_OPT_FRAME_CLK_MASTER,
		.frame_clk_freq = SAMPLE_RATE,
		.mem_slab = &audio_slab,
		.block_size = BLOCK_BYTES,
		.timeout = 2000,
	};
	if (i2s_configure(i2s_dev, I2S_DIR_BOTH, &i2s_cfg)) {
		LOG_WRN("i2s configure failed");
		return -EIO;
	}
	bsp_i2s_duplex_fix();

	for (int i = 0; i < 2; i++) {
		void *pre;
		if (k_mem_slab_alloc(&audio_slab, &pre, K_MSEC(50)) == 0) {
			memset(pre, 0, BLOCK_BYTES);
			i2s_write(i2s_dev, pre, BLOCK_BYTES);
		}
	}
	if (i2s_trigger(i2s_dev, I2S_DIR_BOTH, I2S_TRIGGER_START)) {
		LOG_WRN("i2s start failed");
		return -EIO;
	}
	ok = true;
	LOG_INF("audio: ES8311 TX @%u Hz", SAMPLE_RATE);
	return 0;
}

bool audio_ready(void)
{
	return ok;
}

/* queue up to NUM_BLOCKS of PCM; drops silently if the pipe is full —
 * a demod blip is best-effort audio, never worth stalling the SDR loop */
void audio_play(const int16_t *pcm, uint32_t frames)
{
	uint32_t done = 0;

	if (!ok) {
		return;
	}
	while (done < frames) {
		void *buf;
		uint32_t n = frames - done;
		int16_t *dst;

		if (n > BLOCK_FRAMES) {
			n = BLOCK_FRAMES;
		}
		if (k_mem_slab_alloc(&audio_slab, &buf, K_NO_WAIT)) {
			return;
		}
		dst = (int16_t *)buf;
		for (uint32_t i = 0; i < n; i++) {
			dst[i * 2] = dst[i * 2 + 1] = pcm[done + i];
		}
		if (n < BLOCK_FRAMES) {
			memset(dst + n * 2, 0, (BLOCK_FRAMES - n) * 4);
		}
		if (i2s_write(i2s_dev, buf, BLOCK_BYTES)) {
			k_mem_slab_free(&audio_slab, buf);
			return;
		}
		done += n;
	}
}

#else

int audio_init(void) { return -ENODEV; }
bool audio_ready(void) { return false; }
void audio_play(const int16_t *pcm, uint32_t frames)
{
	(void)pcm; (void)frames;
}

#endif
```

## src/audio.h
```c
#pragma once
#include <stdint.h>

int  audio_init(void);                       /* ES8311 + i2s0 TX setup   */
bool audio_ready(void);
void audio_play(const int16_t *pcm, uint32_t frames); /* stereo 48k s16 */
```

## src/sdr.cpp
```c
/* SPDX-License-Identifier: Apache-2.0 */

#include <string.h>
#include <errno.h>
#include <zephyr/kernel.h>
#include <zephyr/sys/byteorder.h>
#include <zephyr/logging/log.h>

#include "sdr.h"

LOG_MODULE_REGISTER(sdr, LOG_LEVEL_INF);

int sdr_pull_all(uint32_t total_len, uint8_t *buf, uint32_t buf_cap,
		 uint32_t *out_len)
{
	uint32_t off = 0;
	int ret = 0, idle = 0;

	(void)total_len;
	while (off < buf_cap) {
		uint32_t got = 0, total = 0, roff = 0;

		ret = esp_ng_sdr_iq_read(off, buf + off, buf_cap - off,
					 &got, &total, &roff);
		if (ret == -ENOENT) {
			ret = 0;
			break;
		}
		if (ret == -EAGAIN) {
			if (++idle > 100) {
				ret = 0;
				break;
			}
			k_msleep(2);
			continue;
		}
		if (ret) {
			return ret;
		}
		idle = 0;
		if (roff != off) {
			off = roff; /* lagging read lost stale bytes — resync */
		}
		if (!got) {
			break; /* slave has no more staged data */
		}
		off += got;
	}
	*out_len = off;
	return ret;
}

int sdr_spec_pull(uint32_t freq_hz, uint16_t nfft, uint8_t stride,
		  uint8_t units_per_frame, uint8_t max_hold,
		  uint32_t gain, uint32_t dcap, uint32_t duration_ms,
		  uint8_t *buf, uint32_t buf_cap, uint32_t *out_len,
		  struct esp_ng_sdr_run_res *res)
{
	struct esp_ng_sdr_spec_req req = {
		.freq_hz = freq_hz,
		.nfft = nfft,
		.stride = stride,
		.units_per_frame = units_per_frame,
		.max_hold = max_hold,
		.stats = 0,
		.gain = gain,
		.dcap = dcap,
		.duration_ms = duration_ms,
	};
	int ret = esp_ng_sdr_spec(&req, res);

	if (ret) {
		return ret;
	}
	return sdr_pull_all(res->total_len, buf, buf_cap, out_len);
}

int sdr_iq_burst_pull(uint32_t freq_hz, uint16_t n_pairs, uint8_t fmt,
		      uint32_t gain, uint32_t dcap,
		      uint8_t *buf, uint32_t buf_cap, uint32_t *out_len,
		      struct esp_ng_sdr_run_res *res)
{
	struct esp_ng_sdr_iq_req req = {
		.freq_hz = freq_hz,
		.mode = 0,
		.n_words = n_pairs,
		.units = 0,
		.format = fmt,
		.gain = gain,
		.dcap = dcap,
		.duration_ms = 0,
	};
	int ret = esp_ng_sdr_iq_start(&req, res);

	if (ret) {
		return ret;
	}
	return sdr_pull_all(res->total_len, buf, buf_cap, out_len);
}

/* Factory RF-test CW tone — emits real RF on the C6's TX chain.
 * backoff_qdb: 0.25 dB attenuation units (0 = full power). On return,
 * res->pairs echoes the Wi-Fi channel used, res->detail = 1 when on. */
int sdr_tone(uint32_t freq_hz, bool on, uint32_t backoff_qdb,
	     struct esp_ng_sdr_run_res *res)
{
	struct esp_ng_sdr_iq_req req = {
		.freq_hz = freq_hz,
		.mode = on ? 2 : 3,
		.gain = backoff_qdb,
		.dcap = ESP_NG_SDR_DCAP_KEEP,
	};
	return esp_ng_sdr_iq_start(&req, res);
}

/* Consume complete SPC1/SPS1 records from the front of buf; returns
 * bytes consumed (a partial trailing record stays for the next chunk).
 * Sets *halt if cb vetoes the stream. */
static uint32_t spc1_consume(const uint8_t *buf, uint32_t len,
			     bool (*cb)(const struct sdr_spc1 *,
					const uint8_t *, void *),
			     void *arg, int *frames, bool *halt)
{
	uint32_t off = 0;

	while (off + 4 <= len) {
		uint32_t magic;
		uint32_t flen;

		memcpy(&magic, buf + off, 4);
		if (magic == SDR_SPC1_MAGIC) {
			struct sdr_spc1 h;
			uint32_t nfft;

			if (off + SDR_SPC1_HDR > len) {
				break;
			}
			memcpy(&h, buf + off, sizeof(h));
			nfft = 1u << (h.nfft_log2 & 0x0f);
			if (!nfft || nfft > 4096) {
				break;
			}
			flen = SDR_SPC1_HDR + nfft + 4;
			if (off + flen > len) {
				break;
			}
			(*frames)++;
			if (cb && !cb(&h, buf + off + SDR_SPC1_HDR, arg)) {
				*halt = true;
				off += flen;
				break;
			}
			off += flen;
		} else if (magic == SDR_SPS1_MAGIC) {
			if (off + 40 > len) {
				break;
			}
			off += 40;
		} else {
			break;
		}
	}
	return off;
}

int sdr_walk_spc1(const uint8_t *buf, uint32_t len,
		  bool (*cb)(const struct sdr_spc1 *h, const uint8_t *bins,
			     void *arg),
		  void *arg)
{
	int frames = 0;
	bool halt = false;

	spc1_consume(buf, len, cb, arg, &frames, &halt);
	return frames;
}

/* Stream a SPEC run: the slave captures asynchronously while we drain
 * the ring live — cb() fires per frame as it lands. Bounded runs end
 * via -ENOENT when drained; unbounded runs (duration_ms = 0) stop after
 * max_frames (esp_ng_sdr_stop) or when cb returns false. */
int sdr_spec_stream(uint32_t freq_hz, uint16_t nfft, uint8_t stride,
		    uint8_t units_per_frame, uint8_t max_hold,
		    uint32_t gain, uint32_t dcap, uint32_t duration_ms,
		    uint32_t max_frames,
		    bool (*cb)(const struct sdr_spc1 *, const uint8_t *,
			       void *),
		    void *arg, uint32_t *out_bytes, int *out_frames)
{
	struct esp_ng_sdr_spec_req req = {
		.freq_hz = freq_hz,
		.nfft = nfft,
		.stride = stride,
		.units_per_frame = units_per_frame,
		.max_hold = max_hold,
		.stats = 0,
		.gain = gain,
		.dcap = dcap,
		.duration_ms = duration_ms,
	};
	struct esp_ng_sdr_run_res res;
	uint32_t consumed = 0, fill = 0;
	static uint8_t acc[2048]; /* read chunk + partial-frame carry */
	int frames = 0, idle = 0, ret;
	bool halt = false;

	ret = esp_ng_sdr_spec(&req, &res);
	if (ret) {
		return ret;
	}
	if (res.resp) {
		return -EIO;
	}
	*out_bytes = 0;
	uint64_t t_data = 0, t_again = 0;
	uint32_t n_data = 0, n_again = 0;
	for (;;) {
		uint32_t got = 0, total = 0, roff = 0;
		uint32_t c0 = k_cycle_get_32();

		ret = esp_ng_sdr_iq_read(consumed, acc + fill,
					 sizeof(acc) - fill,
					 &got, &total, &roff);
		uint32_t us = k_cyc_to_us_floor32(k_cycle_get_32() - c0);
		if (ret == -ENOENT) {
			printk("rd: %u data %u.%ums avg | %u again %u.%ums avg\n",
			       n_data, (uint32_t)(t_data / (n_data ?: 1) / 10),
			       (uint32_t)(t_data / (n_data ?: 1) % 10),
			       n_again, (uint32_t)(t_again / (n_again ?: 1) / 10),
			       (uint32_t)(t_again / (n_again ?: 1) % 10));
			break; /* run over, ring drained */
		}
		if (ret == -EAGAIN) {
			t_again += us; n_again++;
			if (++idle > 300) {
				break; /* run died silently */
			}
			k_msleep(2);
			continue;
		}
		if (ret) {
			esp_ng_sdr_stop();
			return ret;
		}
		t_data += us; n_data++;
		idle = 0;
		if (roff != consumed) {
			consumed = roff; /* overrun gap — drop partial record */
			fill = 0;
		}
		fill += got;
		consumed += got;
		*out_bytes += got;
		uint32_t used = spc1_consume(acc, fill, cb, arg,
					     &frames, &halt);
		if (used) {
			memmove(acc, acc + used, fill - used);
			fill -= used;
		}
		if (halt ||
		    (max_frames && frames >= (int)max_frames)) {
			esp_ng_sdr_stop();
			break;
		}
	}
	*out_frames = frames;
	return frames ? 0 : -ENODATA;
}
```

## src/sdr.h
```c
/* SPDX-License-Identifier: Apache-2.0
 *
 * c6_sdr host-side helpers: pull staged captures off the C6 via the
 * esp_ng_sdr_* RPCs and parse the ESP-SDR SPC1 spectrum frames.
 */
#pragma once

#include <stdint.h>
#include <stddef.h>
#include "esp_hosted_ng.h"

#ifdef __cplusplus
extern "C" {
#endif

/* ESP-SDR "SPC1" spectrum frame (wire, little-endian, packed) */
struct __attribute__((packed)) sdr_spc1 {
	uint32_t magic;        /* 0x31435053 "SPC1" */
	uint32_t frame_seq;
	uint64_t pair_index;
	uint32_t pairs;
	uint16_t ffts;
	uint8_t  flags;        /* bit0 max-hold, bit1 abandoned, bit2 dropped */
	uint8_t  gain;
	uint16_t drops;
	uint8_t  nfft_log2;
	uint8_t  db_step;
};
#define SDR_SPC1_MAGIC 0x31435053u
#define SDR_SPS1_MAGIC 0x31535053u /* stats frame, 36+4 B */
#define SDR_SPC1_HDR   28u

/* Run one bounded SPEC capture on the C6 and pull every staged frame into
 * buf. Returns 0 on a clean run (res->status == 0 as well), negative errno
 * otherwise; *out_len receives staged bytes copied. */
int sdr_spec_pull(uint32_t freq_hz, uint16_t nfft, uint8_t stride,
		  uint8_t units_per_frame, uint8_t max_hold,
		  uint32_t gain, uint32_t dcap, uint32_t duration_ms,
		  uint8_t *buf, uint32_t buf_cap, uint32_t *out_len,
		  struct esp_ng_sdr_run_res *res);

/* Pull staged bytes after a Spec/IqStart call; returns copied length. */
int sdr_pull_all(uint32_t total_len, uint8_t *buf, uint32_t buf_cap,
		 uint32_t *out_len);

/* Stream a SPEC capture: the slave runs asynchronously and cb() fires
 * per SPC1 frame as it lands on the host. duration_ms bounds the run
 * (0 = run until max_frames / cb false / slave stall); max_frames = 0
 * drains to the natural end. Returns 0 with *out_frames/*out_bytes set,
 * -ENODATA if nothing arrived, or a negative transport error. */
int sdr_spec_stream(uint32_t freq_hz, uint16_t nfft, uint8_t stride,
		    uint8_t units_per_frame, uint8_t max_hold,
		    uint32_t gain, uint32_t dcap, uint32_t duration_ms,
		    uint32_t max_frames,
		    bool (*cb)(const struct sdr_spc1 *, const uint8_t *,
			       void *),
		    void *arg, uint32_t *out_bytes, int *out_frames);

/* Iterate SPC1 frames in a pulled blob. Returns parsed frame count;
 * cb() runs per frame with header + bins (NULL-safe to skip SPS1/other
 * records). cb return false stops the walk. */
int sdr_walk_spc1(const uint8_t *buf, uint32_t len,
		  bool (*cb)(const struct sdr_spc1 *h, const uint8_t *bins,
			     void *arg),
		  void *arg);

/* One-shot raw-IQ burst into buf (mode 0). fmt: 0 = raw u32 words,
 * 16 = iq8 (2 B/pair), 20 = iq10 (5 B/2 pairs). */
int sdr_iq_burst_pull(uint32_t freq_hz, uint16_t n_pairs, uint8_t fmt,
		      uint32_t gain, uint32_t dcap,
		      uint8_t *buf, uint32_t buf_cap, uint32_t *out_len,
		      struct esp_ng_sdr_run_res *res);

/* Factory RF-test CW tone on/off (IqStart mode 2/3) — emits real RF.
 * backoff_qdb: attenuation in 0.25 dB units, 0 = full PA power. */
int sdr_tone(uint32_t freq_hz, bool on, uint32_t backoff_qdb,
	     struct esp_ng_sdr_run_res *res);

#ifdef __cplusplus
}
#endif
```
