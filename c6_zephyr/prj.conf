## CMakeLists.txt
```
# Copyright (c) 2026
# SPDX-License-Identifier: Apache-2.0

cmake_minimum_required(VERSION 3.20.0)
find_package(Zephyr REQUIRED HINTS $ENV{ZEPHYR_BASE})
project(c6_zephyr)

# nanopb — reuse the P4 driver's .proto verbatim for wire compatibility.
list(APPEND CMAKE_MODULE_PATH ${ZEPHYR_BASE}/modules/nanopb)
include(nanopb)
zephyr_nanopb_sources(app src/esp_hosted_rpc.proto)

target_sources(app PRIVATE
	src/main.c
	src/link.c
	src/rpc.c
	src/ota_boot.c
)
target_include_directories(app PRIVATE src ${CMAKE_CURRENT_BINARY_DIR} ${CMAKE_CURRENT_BINARY_DIR}/src)
```

## prj.conf
```kconfig
# Zephyr-hosted ESP32-C6 slave application for c6_sdr.
# Boot: ESP-IDF 2nd-stage bootloader + otadata (OTA images into ota_0/ota_1).
CONFIG_ESP_C6_OTA_BOOT_PROBE=y

# SDIO slave peripheral (hosted transport to P4).
CONFIG_ESP32C6_SDIO_SLAVE=y

# Hosted RPC wire codec + OTA flash writes.
CONFIG_NANOPB=y
CONFIG_FLASH=y
CONFIG_FLASH_MAP=y
CONFIG_FLASH_PAGE_LAYOUT=y

CONFIG_LOG=y
CONFIG_PRINTK=y
CONFIG_THREAD_NAME=y
CONFIG_MAIN_STACK_SIZE=8192
CONFIG_SYSTEM_WORKQUEUE_STACK_SIZE=4096
CONFIG_HEAP_MEM_POOL_SIZE=32768
CONFIG_CRC=y
```

## src/main.c
```c
/* SPDX-License-Identifier: Apache-2.0
 * Zephyr ESP32-C6 hosted slave — SDIO link + hosted RPC + OTA.
 *
 * Runs from an IDF OTA slot; keeps the stock ESP-IDF 2nd-stage
 * bootloader + otadata. If the hosted data path never opens (driver
 * regression, bad image), a watchdog rewrites otadata back to the other
 * slot and reboots — the IDF bootloader then brings up the known-good
 * hybrid firmware again.
 */

#include <zephyr/kernel.h>
#include <zephyr/logging/log.h>
#include <zephyr/fatal.h>
#include <esp_system.h>
#include "esp_hosted_rpc.pb.h"

#include "wire.h"
#include "link.h"
#include "rpc.h"
#include "ota_boot.h"

LOG_MODULE_REGISTER(c6_sdr, LOG_LEVEL_INF);

#define FALLBACK_TIMEOUT_S   90
#define HEARTBEAT_PERIOD_S   30

static struct k_work_delayable fallback_work;
static struct k_work_delayable hb_work;
static uint32_t hb_num;

static void fallback_revert(void)
{
	int slot = c6_ota_current_slot();

	if (slot >= 0) {
		LOG_ERR("no datapath after %us — reverting to ota_%d",
			FALLBACK_TIMEOUT_S, slot ^ 1);
		c6_ota_select_boot(slot ^ 1);
	} else {
		LOG_ERR("no datapath — rebooting (slot unknown)");
	}
	esp_restart();
}

static void fallback_handler(struct k_work *work)
{
	if (!c6_link_datapath()) {
		fallback_revert();
	}
}

static void hb_handler(struct k_work *work)
{
	if (c6_link_datapath()) {
		c6_rpc_send_event(RpcId_Event_Heartbeat, hb_num);
		hb_num++;
	}
	k_work_schedule(&hb_work, K_SECONDS(HEARTBEAT_PERIOD_S));
}

static void serial_rx(const uint8_t *ep, uint8_t ep_len,
		      const uint8_t *data, uint16_t data_len)
{
	if (ep_len == 6 && memcmp(ep, C6_EP_RSP, 6) == 0) {
		c6_rpc_dispatch(data, data_len);
	}
}

static void on_open_datapath(void)
{
	/* cancel the fallback — link is coming up */
	k_work_cancel_delayable(&fallback_work);
	/* hosted-ng expects the ESPInit protobuf event on RPCEvt */
	c6_rpc_send_event(RpcId_Event_ESPInit, 0);
	k_work_schedule(&hb_work, K_SECONDS(5));
}

int main(void)
{
	int ret;

	k_work_init_delayable(&fallback_work, fallback_handler);
	k_work_init_delayable(&hb_work, hb_handler);

	LOG_INF("c6_zephyr: sdio hosted slave");
	c6_ota_detect();
	ret = c6_link_init(serial_rx, on_open_datapath);
	if (ret) {
		LOG_ERR("link init: %d", ret);
		fallback_revert();
		return ret;
	}

	/* If the host never opens the data path, revert to the other slot
	 * so we don't leave the C6 stranded on a broken image. */
	k_work_schedule(&fallback_work, K_SECONDS(FALLBACK_TIMEOUT_S));

	LOG_INF("sdio slave ready, waiting for host");
	for (;;) {
		c6_ota_reboot_later();
		k_msleep(50);
	}
	return 0;
}

/* Fatal-error escape: try to leave a bootable fallback before dying. */
void k_sys_fatal_error_handler(unsigned int reason,
			       const struct arch_esf *esf)
{
	ARG_UNUSED(esf);
	int slot = c6_ota_current_slot();

	(void)reason;
	if (slot >= 0) {
		c6_ota_select_boot(slot ^ 1);
	}
	esp_restart();
}
```

## src/link.c
```c
/* SPDX-License-Identifier: Apache-2.0
 * SDIO link layer — esp_payload_header framing over the ported
 * sdio_slave driver. Mirrors the ESP-Hosted slave data path.
 */

#include <string.h>
#include <zephyr/kernel.h>
#include <zephyr/sys/byteorder.h>
#include <zephyr/logging/log.h>
#include <drivers/esp32c6_sdio_slave.h>

#include <esp_system.h>

#include "wire.h"
#include "link.h"

LOG_MODULE_DECLARE(c6_sdr, LOG_LEVEL_INF);

#define RX_THREAD_STACK 4096
#define RX_THREAD_PRIO  K_PRIO_COOP(5)

static c6_serial_cb_t serial_cb;
static c6_open_cb_t   open_cb;
static volatile bool  datapath;

/* slave -> host */
static uint16_t tx_seq;
static struct k_mutex tx_lock;

/* host -> slave serial reassembly */
static uint8_t  ser_acc[C6_RX_BUFSZ];
static uint32_t ser_len;
static uint16_t ser_seq;
static bool     ser_inframe;

/* rx buffers registered with the slave DMA */
static uint8_t rx_buf[C6_SDIO_NUM_BUFS][C6_SDIO_BUF] __aligned(4);

static K_THREAD_STACK_DEFINE(rx_stack, RX_THREAD_STACK);
static struct k_thread rx_thread;

static uint16_t esp_checksum(const uint8_t *buf, uint32_t len)
{
	uint32_t c = 0;

	for (uint32_t i = 0; i < len; i++) {
		c += buf[i];
	}
	return c & 0xFFFF;
}

static struct k_work hostint_work;
static volatile uint32_t hostint_bits;

/* Runs in work-queue context — callbacks may sleep/lock. */
static void hostint_worker(struct k_work *work)
{
	uint32_t bits;

	ARG_UNUSED(work);
	bits = hostint_bits;
	hostint_bits = 0;

	if (bits & BIT(C6_EV_OPEN_DATA_PATH)) {
		if (!datapath) {
			datapath = true;
			LOG_INF("data path open");
			if (open_cb) {
				open_cb();
			}
		}
	}
	if (bits & BIT(C6_EV_CLOSE_DATA_PATH)) {
		datapath = false;
		LOG_INF("data path closed");
	}
	if (bits & BIT(C6_EV_RESET)) {
		LOG_WRN("host requested reset");
		k_msleep(20);          /* let the log out */
		esp_restart();
	}
}

/* Called from ISR context with the host->slave interrupt number (slvint
 * bit index). Bit n fires when the host writes BIT(n) to SCRATCH7.
 */
static void host_int_cb(uint8_t pos)
{
	if (pos < 8) {
		hostint_bits |= BIT(pos);
		k_work_submit(&hostint_work);
	}
}

/* Parse the serial TLV stream accumulated in ser_acc; call serial_cb for
 * each complete "endpoint + data" unit. Returns consumed length. */
static void serial_drain(void)
{
	uint32_t pos = 0;

	while (ser_len - pos >= 3) {
		uint16_t ep_len, data_len;
		uint32_t p = pos;

		if (ser_acc[p] != C6_TLV_EP_NAME) {
			LOG_WRN("serial tlv: bad ep tag %02x", ser_acc[p]);
			break;
		}
		ep_len = ser_acc[p + 1] | (ser_acc[p + 2] << 8);
		if (ep_len == 0 || ep_len >= 16) {
			break;
		}
		p += 3;
		if (p + ep_len + 3 > ser_len) {
			break;                    /* incomplete */
		}
		if (ser_acc[p + ep_len] != C6_TLV_DATA) {
			LOG_WRN("serial tlv: bad data tag");
			break;
		}
		data_len = ser_acc[p + ep_len + 1] |
			   (ser_acc[p + ep_len + 2] << 8);
		if (p + ep_len + 3 + data_len > ser_len) {
			break;                    /* incomplete */
		}
		if (serial_cb) {
			serial_cb(&ser_acc[p], ep_len,
				  &ser_acc[p + ep_len + 3], data_len);
		}
		pos = p + ep_len + 3 + data_len;
	}
	if (pos) {
		ser_len -= pos;
		memmove(ser_acc, ser_acc + pos, ser_len);
	}
}

/* Accumulate a serial-frame payload; handles esp-frame fragmentation via
 * seq_num + MORE_FRAGMENT (same as process_serial_rx_pkt in the IDF fw). */
static void serial_rx(const struct c6_hdr *hdr, const uint8_t *payload,
		      uint16_t plen)
{
	uint16_t seq = sys_le16_to_cpu(hdr->seq_num);
	uint8_t flags = hdr->flags;

	if (!ser_inframe) {
		ser_seq = seq;
		ser_inframe = true;
		ser_len = 0;
	} else if (seq != ser_seq) {
		/* desync — drop stale partial and start fresh */
		ser_len = 0;
		ser_seq = seq;
	}

	if (plen > sizeof(ser_acc) - ser_len) {
		LOG_WRN("serial acc overrun %u+%u", ser_len, plen);
		ser_len = 0;
		ser_inframe = false;
		return;
	}
	memcpy(ser_acc + ser_len, payload, plen);
	ser_len += plen;

	if (!(flags & C6_FLAG_MORE_FRAG)) {
		serial_drain();
		ser_inframe = false;
	}
}

static void rx_entry(void *p1, void *p2, void *p3)
{
	sdio_slave_buf_handle_t h;
	uint8_t *addr;
	size_t len;
	int ret;

	ARG_UNUSED(p1);
	ARG_UNUSED(p2);
	ARG_UNUSED(p3);

	for (;;) {
		ret = sdio_slave_recv(&h, &addr, &len, K_FOREVER);
		if (ret != 0 || !addr) {
			continue;
		}
		if (len >= C6_HDR_LEN) {
			const struct c6_hdr *hdr = (const struct c6_hdr *)addr;
			uint8_t if_type = hdr->if_type & 0x0F;
			uint16_t plen = sys_le16_to_cpu(hdr->len);
			uint16_t off = sys_le16_to_cpu(hdr->offset);

			if (if_type == C6_IF_SERIAL && off <= len &&
			    plen <= len - off) {
				serial_rx(hdr, addr + off, plen);
			} else if (if_type != C6_IF_SERIAL) {
				LOG_DBG("rx if %u len %u", if_type, plen);
			}
		}
		sdio_slave_recv_load_buf(h);
	}
}

int c6_link_init(c6_serial_cb_t scb, c6_open_cb_t ocb)
{
	sdio_slave_config_t cfg = {
		.sending_mode     = SDIO_SLAVE_SEND_STREAM,
		.timing           = SDIO_SLAVE_TIMING_PSEND_PSAMPLE,
		.flags            = 0,          /* SDIO_SLAVE_FLAG_HIGH_SPEED */
		.send_queue_size  = 20,
		.recv_buffer_size = C6_SDIO_BUF,
		.event_cb         = host_int_cb,
	};
	int ret;

	serial_cb = scb;
	open_cb = ocb;
	k_mutex_init(&tx_lock);
	k_work_init(&hostint_work, hostint_worker);

	ret = sdio_slave_initialize(&cfg);
	if (ret) {
		LOG_ERR("sdio_slave_initialize: %d", ret);
		return ret;
	}
	for (int i = 0; i < C6_SDIO_NUM_BUFS; i++) {
		sdio_slave_buf_handle_t h =
			sdio_slave_recv_register_buf(rx_buf[i]);

		if (!h || sdio_slave_recv_load_buf(h)) {
			LOG_ERR("recv buf %d", i);
			return -ENOMEM;
		}
	}
	ret = sdio_slave_start();
	if (ret) {
		LOG_ERR("sdio_slave_start: %d", ret);
		return ret;
	}
	LOG_INF("sdio slave up");

	k_thread_create(&rx_thread, rx_stack, RX_THREAD_STACK, rx_entry,
			NULL, NULL, NULL, RX_THREAD_PRIO, 0, K_NO_WAIT);
	k_thread_name_set(&rx_thread, "c6_sdio_rx");
	return 0;
}

/* drain completed tx frames — buffers were malloc'd per fragment */
static void tx_reclaim(void)
{
	void *arg;

	while (sdio_slave_send_get_finished(&arg, K_NO_WAIT) == 0) {
		k_free(arg);
	}
}

int c6_link_tx_serial(const char *ep, const uint8_t *pb, uint16_t pb_len)
{
	uint8_t *tlv, *p;
	uint16_t ep_len = strlen(ep);
	uint32_t tlv_len = 3 + ep_len + 3 + pb_len;
	uint32_t left, off;
	int ret = 0;

	tx_reclaim();
	k_mutex_lock(&tx_lock, K_FOREVER);

	tlv = k_malloc(tlv_len);
	if (!tlv) {
		k_mutex_unlock(&tx_lock);
		return -ENOMEM;
	}

	/* assemble TLV stream: {0x01, ep_len(2), ep, 0x02, data_len(2), pb} */
	p = tlv;
	*p++ = C6_TLV_EP_NAME;
	*p++ = ep_len & 0xFF;
	*p++ = ep_len >> 8;
	memcpy(p, ep, ep_len);
	p += ep_len;
	*p++ = C6_TLV_DATA;
	*p++ = pb_len & 0xFF;
	*p++ = pb_len >> 8;
	memcpy(p, pb, pb_len);

	left = tlv_len;
	off = 0;
	while (left) {
		uint16_t frag = left > C6_MAX_FRAME ? C6_MAX_FRAME : left;
		uint8_t *frame = k_malloc(C6_HDR_LEN + frag);
		struct c6_hdr *hdr;
		int r;

		if (!frame) {
			ret = -ENOMEM;
			break;
		}
		hdr = (struct c6_hdr *)frame;
		memset(hdr, 0, C6_HDR_LEN);
		hdr->if_type = C6_IF_SERIAL;
		hdr->len = sys_cpu_to_le16(frag);
		hdr->offset = sys_cpu_to_le16(C6_DATA_OFFSET);
		hdr->seq_num = sys_cpu_to_le16(++tx_seq);
		hdr->flags = (left > C6_MAX_FRAME) ? C6_FLAG_MORE_FRAG : 0;
		memcpy(frame + C6_HDR_LEN, tlv + off, frag);
		hdr->checksum = sys_cpu_to_le16(
			esp_checksum(frame, C6_HDR_LEN + frag));

		r = sdio_slave_send_queue(frame, C6_HDR_LEN + frag, frame,
					  K_SECONDS(10));
		if (r) {
			LOG_ERR("tx queue: %d", r);
			k_free(frame);
			ret = r;
			break;
		}
		off += frag;
		left -= frag;
	}

	k_free(tlv);
	k_mutex_unlock(&tx_lock);
	return ret;
}

bool c6_link_datapath(void)
{
	return datapath;
}
```

## src/link.h
```c
/* SPDX-License-Identifier: Apache-2.0
 * SDIO link layer — esp_payload_header framing over the sdio_slave driver.
 */
#pragma once

#include <stdint.h>
#include <zephyr/kernel.h>

typedef void (*c6_serial_cb_t)(const uint8_t *ep, uint8_t ep_len,
			       const uint8_t *data, uint16_t data_len);
typedef void (*c6_open_cb_t)(void);

int  c6_link_init(c6_serial_cb_t serial_cb, c6_open_cb_t open_cb);
/* Send a protobuf blob wrapped in a serial TLV on the given endpoint.
 * Fragments into <=1500-byte payload frames automatically. */
int  c6_link_tx_serial(const char *ep, const uint8_t *pb, uint16_t pb_len);

bool c6_link_datapath(void);
```

## src/ota_boot.c
```c
/* SPDX-License-Identifier: Apache-2.0
 * ESP-IDF-compatible OTA control over the raw flash device.
 *
 * otadata @ 0xd000 holds two 32-byte esp_ota_select_entry_t records
 * (sector 0 and sector 1). The bootloader picks the record with a valid
 * crc and the highest ota_seq; slot = (ota_seq - 1) % ota_app_count.
 */

#include <string.h>
#include <zephyr/kernel.h>
#include <zephyr/sys/crc.h>
#include <zephyr/drivers/flash.h>
#include <zephyr/device.h>
#include <zephyr/devicetree.h>
#include <zephyr/logging/log.h>
#include <esp_system.h>

#include "ota_boot.h"

LOG_MODULE_DECLARE(c6_sdr, LOG_LEVEL_INF);

#define OTADATA_BASE    0xD000
#define OTADATA_OFF0    0x0000
#define OTADATA_OFF1    0x1000
#define OTA_SLOT_BASE0  0x10000
#define OTA_SLOT_BASE1  0x190000
#define OTA_SLOT_SIZE   0x180000     /* 1536K */
#define OTA_SLOT_COUNT  2
#define OTA_IMG_VALID   2            /* ESP_OTA_IMG_VALID */
#define OTA_IMG_INVALID 3            /* ESP_OTA_IMG_INVALID — never selectable */
#define OTA_IMG_ABORTED 4            /* ESP_OTA_IMG_ABORTED — never selectable */

struct ota_select_entry {
	uint32_t ota_seq;
	uint8_t  seq_label[20];
	uint32_t ota_state;
	uint32_t crc;
};

static const struct device *flash_dev =
	DEVICE_DT_GET(DT_CHOSEN(zephyr_flash_controller));
static const uint32_t slot_base[OTA_SLOT_COUNT] = {
	OTA_SLOT_BASE0, OTA_SLOT_BASE1
};
static int current_slot = -1;

/* ota write state */
static uint32_t ota_off;
static int      ota_target = -1;
static bool     ota_done;

static uint32_t entry_crc(uint32_t seq)
{
	return crc32_ieee_update(UINT32_MAX, (const uint8_t *)&seq, 4);
}

static bool entry_valid(const struct ota_select_entry *e)
{
	return e->crc == entry_crc(e->ota_seq);
}

/* bootloader_common_ota_select_invalid(): an aborted/invalid entry is
 * never selected, whatever its crc. */
static bool entry_invalid(const struct ota_select_entry *e)
{
	return e->ota_seq == UINT32_MAX || e->ota_state == OTA_IMG_INVALID ||
	       e->ota_state == OTA_IMG_ABORTED;
}

static int read_entry(uint32_t off, struct ota_select_entry *e)
{
	return flash_read(flash_dev, OTADATA_BASE + off, e, sizeof(*e));
}


/* Running slot = the slot otadata would have selected this boot. */
static void detect_current_slot(void)
{
	struct ota_select_entry e[2];
	bool v[2];
	uint32_t seq;

	if (current_slot >= 0) {
		return;
	}
	/* Mirror the IDF bootloader: when both records are "invalid"
	 * (seq 0xFFFFFFFF / INVALID / ABORTED) it prints
	 * "No factory image, trying OTA 0" and boots slot 0 whatever
	 * their crc says. Otherwise the highest-seq *selectable* entry
	 * wins. */
	bool inv0 = read_entry(OTADATA_OFF0, &e[0]) != 0 ||
		    entry_invalid(&e[0]);
	bool inv1 = read_entry(OTADATA_OFF1, &e[1]) != 0 ||
		    entry_invalid(&e[1]);

	if (inv0 && inv1) {
		current_slot = 0;
		LOG_INF("running from ota_0 (otadata fallback)");
		return;
	}
	v[0] = !inv0 && entry_valid(&e[0]);
	v[1] = !inv1 && entry_valid(&e[1]);
	if (!v[0] && !v[1]) {
		current_slot = 0;
		LOG_INF("running from ota_0 (no valid otadata)");
		return;
	}
	seq = !v[0] ? e[1].ota_seq :
	      !v[1] ? e[0].ota_seq :
	      (e[0].ota_seq > e[1].ota_seq ? e[0].ota_seq : e[1].ota_seq);
	current_slot = (int)((seq - 1) % OTA_SLOT_COUNT);
	LOG_INF("running from ota_%d (ota_seq %u)", current_slot, seq);
}

void c6_ota_detect(void)
{
	detect_current_slot();
}

int c6_ota_current_slot(void)
{
	return current_slot;
}

int c6_ota_select_boot(int slot)
{
	struct ota_select_entry e[2], nw;
	uint32_t seq, new_off;
	bool v0, v1;
	int active, ret;

	v0 = read_entry(OTADATA_OFF0, &e[0]) == 0 && entry_valid(&e[0]);
	v1 = read_entry(OTADATA_OFF1, &e[1]) == 0 && entry_valid(&e[1]);
	seq = v0 ? e[0].ota_seq : 0;
	if (v1 && e[1].ota_seq > seq) {
		seq = e[1].ota_seq;
	}
	/* smallest seq > current that maps to target slot */
	while (((seq - 1 + 1) % OTA_SLOT_COUNT) != slot) {
		seq++;
	}
	seq++;  /* now (seq-1)%2 == slot */

	memset(&nw, 0xFF, sizeof(nw));
	nw.ota_seq = seq;
	nw.ota_state = OTA_IMG_VALID;
	nw.crc = entry_crc(seq);

	/* write to the sector opposite the currently-active (newest) entry */
	active = (v1 && (!v0 || e[1].ota_seq > e[0].ota_seq)) ? 1 : 0;
	new_off = active ? OTADATA_OFF0 : OTADATA_OFF1;

	ret = flash_erase(flash_dev, OTADATA_BASE + new_off, 0x1000);
	if (!ret) {
		ret = flash_write(flash_dev, OTADATA_BASE + new_off,
				  &nw, sizeof(nw));
	}
	if (ret) {
		LOG_ERR("otadata write: %d", ret);
		return ret;
	}
	LOG_INF("otadata -> ota_%d (seq %u)", slot, seq);
	return 0;
}

int c6_ota_begin(void)
{
	int ret;

	detect_current_slot();
	ota_target = current_slot < 0 ? 1 : (current_slot ^ 1);
	ota_off = 0;
	ota_done = false;
	LOG_INF("ota begin -> ota_%d", ota_target);
	ret = flash_erase(flash_dev, slot_base[ota_target], OTA_SLOT_SIZE);
	if (ret) {
		LOG_ERR("slot erase: %d", ret);
		return ret;
	}
	return 0;
}

int c6_ota_write(const uint8_t *data, uint32_t len)
{
	uint32_t pad;
	int ret;

	if (ota_target < 0 || ota_done) {
		return -EINVAL;
	}
	pad = (4 - (len & 3)) & 3;
	ret = flash_write(flash_dev, slot_base[ota_target] + ota_off,
			  data, len);
	if (!ret && pad) {
		uint8_t z[3] = {0};

		ret = flash_write(flash_dev,
				  slot_base[ota_target] + ota_off + len,
				  z, pad);
	}
	if (ret) {
		LOG_ERR("ota write @%u: %d", ota_off, ret);
		return ret;
	}
	ota_off += len;
	return 0;
}

int c6_ota_end(void)
{
	int ret;

	if (ota_target < 0) {
		return -EINVAL;
	}
	/* The IDF bootloader validates the image before jumping and
	 * auto-falls-back to the other slot if it fails — that's the
	 * recovery path for a bad write. */
	ret = c6_ota_select_boot(ota_target);
	if (!ret) {
		ota_done = true;
	}
	return ret;
}

void c6_ota_reboot_later(void)
{
	if (!ota_done) {
		return;
	}
	LOG_INF("ota done — rebooting");
	k_sleep(K_MSEC(100));
	esp_restart();
}
```

## src/ota_boot.h
```c
/* SPDX-License-Identifier: Apache-2.0
 * ESP-IDF-compatible OTA control: otadata select + hosted OTA RPCs.
 */
#pragma once

#include <stdint.h>
#include <stdbool.h>

/* Must run early at boot so the fallback path knows the running slot. */
void c6_ota_detect(void);
/* Current OTA slot this image booted from (0=ota_0, 1=ota_1, -1=unknown). */
int  c6_ota_current_slot(void);
/* Write otadata so the IDF bootloader selects `slot` next boot. */
int  c6_ota_select_boot(int slot);

/* Hosted OTA RPC handlers (slave side). */
int  c6_ota_begin(void);
int  c6_ota_write(const uint8_t *data, uint32_t len);
int  c6_ota_end(void);
/* Reboot into whatever otadata says — called shortly after c6_ota_end. */
void c6_ota_reboot_later(void);
```

## src/rpc.c
```c
/* SPDX-License-Identifier: Apache-2.0
 * ESP-Hosted-NG RPC dispatch + minimal handler set:
 *   ESPInit event, GetMacAddress, GetCoprocessorFwVersion, OTA stubs.
 */

#include <string.h>
#include <zephyr/kernel.h>
#include <zephyr/logging/log.h>
#include <zephyr/sys/byteorder.h>
#include <pb_decode.h>
#include <pb_encode.h>
#include <esp_efuse.h>
#include <esp_efuse_table.h>

#include "esp_hosted_rpc.pb.h"
#include "wire.h"
#include "link.h"
#include "rpc.h"
#include "ota_boot.h"

LOG_MODULE_DECLARE(c6_sdr, LOG_LEVEL_INF);

/* Rpc is ~4.4 KB — static, rpc is serialized anyway. */
static Rpc tx_msg;
static uint8_t pb_buf[1600];

/* MAC address: factory-programmed efuse base MAC (ESP_EFUSE_MAC in
 * EFUSE_BLK1). Falls back to a locally-administered OUI if unread. */
static void get_base_mac(uint8_t mac[6])
{
	if (esp_efuse_read_field_blob(ESP_EFUSE_MAC_FACTORY, mac, 48) != 0 ||
	    (mac[0] == 0 && mac[1] == 0 && mac[2] == 0)) {
		mac[0] = 0x02; mac[1] = 0xC6; mac[2] = 0x5D;
		mac[3] = 0x00; mac[4] = 0x00; mac[5] = 0x01;
	}
}

static int rpc_tx(Rpc *msg, const char *ep)
{
	pb_ostream_t os = pb_ostream_from_buffer(pb_buf, sizeof(pb_buf));
	int ret;

	if (!pb_encode(&os, Rpc_fields, msg)) {
		LOG_ERR("pb encode %u: %s", msg->msg_id, PB_GET_ERROR(&os));
		return -EINVAL;
	}
	ret = c6_link_tx_serial(ep, pb_buf, os.bytes_written);
	return ret;
}

/* Send an event. hb_num is ignored for non-heartbeat ids. */
int c6_rpc_send_event(uint32_t msg_id, uint32_t hb_num)
{
	memset(&tx_msg, 0, sizeof(tx_msg));
	tx_msg.msg_type = RpcType_Event;
	tx_msg.msg_id = msg_id;
	tx_msg.uid = 0;
	switch (msg_id) {
	case RpcId_Event_ESPInit:
		tx_msg.which_payload = Rpc_event_esp_init_tag;
		break;
	case RpcId_Event_Heartbeat:
		tx_msg.which_payload = Rpc_event_heartbeat_tag;
		tx_msg.payload.event_heartbeat.hb_num = hb_num;
		break;
	default:
		return -EINVAL;
	}
	return rpc_tx(&tx_msg, C6_EP_EVT);
}

static int rpc_resp(Rpc *req)
{
	req->msg_type = RpcType_Resp;
	req->msg_id = req->which_payload;
	return rpc_tx(req, C6_EP_RSP);
}

int c6_rpc_dispatch(const uint8_t *pb, uint16_t pb_len)
{
	static Rpc req;
	pb_istream_t is = pb_istream_from_buffer(pb, pb_len);

	memset(&req, 0, sizeof(req));
	if (!pb_decode(&is, Rpc_fields, &req)) {
		LOG_WRN("pb decode: %s", PB_GET_ERROR(&is));
		return -EINVAL;
	}
	if (req.msg_type != RpcType_Req) {
		return 0;
	}

	switch (req.msg_id) {
	case RpcId_Req_GetMACAddress: {
		uint8_t mac[6];

		get_base_mac(mac);
		req.which_payload = Rpc_resp_get_mac_address_tag;
		req.payload.resp_get_mac_address.resp = 0;
		req.payload.resp_get_mac_address.mac.size = 6;
		memcpy(req.payload.resp_get_mac_address.mac.bytes, mac, 6);
		LOG_INF("resp mac %02x:%02x:%02x:%02x:%02x:%02x",
			mac[0], mac[1], mac[2], mac[3], mac[4], mac[5]);
		return rpc_resp(&req);
	}
	case RpcId_Req_GetCoprocessorFwVersion:
		req.which_payload = Rpc_resp_get_coprocessor_fwversion_tag;
		req.payload.resp_get_coprocessor_fwversion.resp = 0;
		req.payload.resp_get_coprocessor_fwversion.major1 = 1;
		req.payload.resp_get_coprocessor_fwversion.minor1 = 4;
		req.payload.resp_get_coprocessor_fwversion.patch1 = 90;
		return rpc_resp(&req);
	/* Transport-lifecycle RPCs the host issues during bring-up. This
	 * firmware has no Wi-Fi data path; acknowledging them is what lets
	 * the hosted link come up so control/OTA/SDR RPCs can run. */
	case RpcId_Req_WifiInit:
		req.which_payload = Rpc_resp_wifi_init_tag;
		req.payload.resp_wifi_init.resp = 0;
		return rpc_resp(&req);
	case RpcId_Req_SetWifiMode:
		req.which_payload = Rpc_resp_set_wifi_mode_tag;
		req.payload.resp_set_wifi_mode.resp = 0;
		return rpc_resp(&req);
	case RpcId_Req_WifiStart:
		req.which_payload = Rpc_resp_wifi_start_tag;
		req.payload.resp_wifi_start.resp = 0;
		return rpc_resp(&req);
	case RpcId_Req_OTABegin:
		req.which_payload = Rpc_resp_ota_begin_tag;
		req.payload.resp_ota_begin.resp = c6_ota_begin();
		return rpc_resp(&req);
	case RpcId_Req_OTAWrite:
		req.which_payload = Rpc_resp_ota_write_tag;
		req.payload.resp_ota_write.resp =
			c6_ota_write(req.payload.req_ota_write.ota_data.bytes,
				     req.payload.req_ota_write.ota_data.size);
		return rpc_resp(&req);
	case RpcId_Req_OTAEnd:
		req.which_payload = Rpc_resp_ota_end_tag;
		req.payload.resp_ota_end.resp = c6_ota_end();
		return rpc_resp(&req);
	case RpcId_Req_ConfigHeartbeat:
		/* accept and ack — heartbeat events not yet generated */
		req.which_payload = Rpc_resp_config_heartbeat_tag;
		req.payload.resp_config_heartbeat.resp = 0;
		return rpc_resp(&req);
	default:
		/* Drop the request — the host times out and treats it as
		 * unsupported, which is safer than a fake resp=0 success. */
		LOG_WRN("unhandled rpc %u — dropped", req.msg_id);
		return 0;
	}
}
```

## src/rpc.h
```c
/* SPDX-License-Identifier: Apache-2.0
 * ESP-Hosted-NG RPC dispatch (nanopb) + minimal handler set.
 */
#pragma once

#include <stdint.h>

int  c6_rpc_dispatch(const uint8_t *pb, uint16_t pb_len);
int  c6_rpc_send_event(uint32_t msg_id, uint32_t hb_num);
```

## src/wire.h
```c
/* SPDX-License-Identifier: Apache-2.0
 * ESP-Hosted wire protocol constants — shared between the P4 host driver
 * (esp_hosted_ng) and this Zephyr slave. Keep in sync with
 * projects/c6_sdr/common/ and zephyr-esp32p4-v1-bsp esp_hosted_ng.h.
 */
#pragma once

#include <stdint.h>
#include <zephyr/sys/util.h>

/* 12-byte payload header (same layout as esp_payload_header). */
struct c6_hdr {
	uint8_t  if_type;      /* if_type[3:0], if_num[7:4] */
	uint8_t  flags;
	uint16_t len;          /* payload length */
	uint16_t offset;       /* offset of payload inside frame */
	uint16_t checksum;
	uint16_t seq_num;
	uint8_t  throttle;
	uint8_t  reserved2;
} __packed;

#define C6_HDR_LEN        sizeof(struct c6_hdr)
#define C6_DATA_OFFSET    C6_HDR_LEN
#define C6_FLAG_MORE_FRAG BIT(0)

/* interface type nibble values (esp_hosted_if_type_t) */
#define C6_IF_STA    1
#define C6_IF_AP     2
#define C6_IF_SERIAL 3
#define C6_IF_HCI    4
#define C6_IF_PRIV   5
#define C6_IF_TEST   6

/* serial-channel TLV */
#define C6_TLV_EP_NAME 0x01
#define C6_TLV_DATA    0x02
#define C6_EP_RSP      "RPCRsp"
#define C6_EP_EVT      "RPCEvt"

/* host->slave interrupt numbers (esp_hosted_transport_init.h): the host
 * writes BIT(n) to SCRATCH7 (card addr 0x8C); the slave receives slave
 * interrupt bit n.
 */
#define C6_EV_OPEN_DATA_PATH    0
#define C6_EV_CLOSE_DATA_PATH   1
#define C6_EV_RESET             2

#define C6_MAX_FRAME      1600   /* max payload per esp frame */
#define C6_RX_BUFSZ       (C6_MAX_FRAME + C6_HDR_LEN + 64)
#define C6_TX_BUFSZ       (C6_MAX_FRAME + C6_HDR_LEN + 64)
#define C6_SDIO_BUF       1536   /* ESSL rx buffer size (must match host) */
#define C6_SDIO_NUM_BUFS  20
```
